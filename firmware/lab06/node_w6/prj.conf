## CMakeLists.txt
```
cmake_minimum_required(VERSION 3.20.0)
find_package(Zephyr REQUIRED HINTS $ENV{ZEPHYR_BASE})
project(soilsense_node_w6)

target_sources(app PRIVATE src/main.c)
```

## prj.conf
```kconfig
CONFIG_GPIO=y
CONFIG_ADC=y
CONFIG_SERIAL=y
CONFIG_CONSOLE=y
CONFIG_UART_CONSOLE=y
CONFIG_MAIN_STACK_SIZE=1536
CONFIG_IDLE_STACK_SIZE=256
CONFIG_ISR_STACK_SIZE=512
CONFIG_SYSTEM_WORKQUEUE_STACK_SIZE=512

# Week 4 Task D: per-thread stack high-water marks, printed by the `threads` command
CONFIG_THREAD_NAME=y
CONFIG_THREAD_ANALYZER=y
CONFIG_THREAD_ANALYZER_USE_PRINTK=y

# Week 6, Task C: the console's CPU time during `calib` (k_thread_runtime_stats)
CONFIG_THREAD_RUNTIME_STATS=y
CONFIG_SCHED_THREAD_USAGE=y
```

## src/main.c
```c
/*
 * SoilSense Control — week 6: the week-4 node plus
 *   Task B: control and the console share a lock (k_sem or PI k_mutex, chosen
 *           at run time with `lock sem|mutex`); `inv` reproduces the inversion
 *           (low = console holds the lock, high = control asks for it,
 *           medium = telemetry burns CPU and never touches it).
 *   Task C: the e-stop detection is marked on instr_flow (GPIO15); `calib`
 *           prints its duration and the console's CPU during it.
 *
 * Extra analyzer pin this week: instr_disp (GPIO17, the display is not used)
 * marks the console's critical section: its width is B.
 *
 * The node's tasks (PROJECT_SCENARIO.md):
 *   sampling  (hard, 1 kHz)  — pressure ADC, e-stop check, valve PWM phase
 *   control   (hard, 10 ms)  — PI loop -> valve duty
 *   console   (firm)         — UART commands (help/status/joy/set/clear/calib)
 *   telemetry (soft, 1 Hz)   — CSV line over the console UART
 *   flow ISR  (hard)         — pulse counting on the flow input pin
 *
 * Every task raises its instrumentation GPIO on entry and drops it on exit:
 * the logic analyzer sees exactly who ran and for how long.
 */

#include <zephyr/kernel.h>
#include <zephyr/device.h>
#include <zephyr/drivers/gpio.h>
#include <zephyr/drivers/adc.h>
#include <zephyr/drivers/uart.h>
#include <zephyr/sys/atomic.h>
#include <zephyr/sys/util.h>
#include <zephyr/sys/printk.h>
#ifdef CONFIG_THREAD_ANALYZER
#include <zephyr/debug/thread_analyzer.h>
#endif
#ifdef CONFIG_CHARACTER_FRAMEBUFFER
#include <zephyr/drivers/display.h>
#include <zephyr/display/cfb.h>
#endif
#include <stdio.h>
#include <stdlib.h>
#include <string.h>

#define SAMPLE_PERIOD_US 1000  /* sampling: 1 kHz */
#define CONTROL_EVERY    10    /* control runs every 10th sample -> 10 ms */
#define TELEMETRY_MS     1000
#define PWM_STEPS        20    /* software PWM on the valve LED: 1 kHz / 20 = 50 Hz */
#define FLOW_BATCH       100   /* pulses accumulated before the batch math runs */
#define ESTOP_MV         3000  /* overpressure threshold */
#define CALIB_ROUNDS     1000  /* `calib` command: rounds of read + settle */
#define DISPLAY_MS       500   /* HMI refresh period */
#define ESTOP_HOLD       50    /* joystick-down samples (at 50 Hz) = 1 s hold */

/* Task B: the inversion experiment */
#define INV_CS_US        3000  /* console's critical section (B) */
#define INV_TELE_US      15000 /* telemetry's CPU burst (medium) */
#define INV_LEAD_MS      8     /* console takes the lock ~2 ms before control's release */

/* ---- Hardware (all optional: missing DT nodes degrade to a synthetic rig) -- */

#define INSTR(node) GPIO_DT_SPEC_GET_OR(DT_NODELABEL(node), gpios, {0})
static const struct gpio_dt_spec instr_samp = INSTR(instr_samp);
static const struct gpio_dt_spec instr_ctrl = INSTR(instr_ctrl);
static const struct gpio_dt_spec instr_cons = INSTR(instr_cons);
static const struct gpio_dt_spec instr_tele = INSTR(instr_tele);
static const struct gpio_dt_spec instr_flow = INSTR(instr_flow);
static const struct gpio_dt_spec instr_disp = INSTR(instr_disp);
static const struct gpio_dt_spec valve_led =
	GPIO_DT_SPEC_GET_OR(DT_ALIAS(led0), gpios, {0});
static const struct gpio_dt_spec flow_pulse =
	GPIO_DT_SPEC_GET_OR(DT_NODELABEL(flow_pulse), gpios, {0});

#if DT_NODE_EXISTS(DT_PATH(zephyr_user)) && \
	DT_NODE_HAS_PROP(DT_PATH(zephyr_user), io_channels)
#define HAS_ADC 1
static const struct adc_dt_spec adc_joy =
	ADC_DT_SPEC_GET_BY_IDX(DT_PATH(zephyr_user), 0);
static const struct adc_dt_spec adc_pressure =
	ADC_DT_SPEC_GET_BY_IDX(DT_PATH(zephyr_user), 1);
#endif

#if DT_HAS_CHOSEN(zephyr_console)
static const struct device *const console_uart =
	DEVICE_DT_GET(DT_CHOSEN(zephyr_console));
#endif

#ifdef CONFIG_CHARACTER_FRAMEBUFFER
static const struct device *const disp = DEVICE_DT_GET_ANY(solomon_ssd1306);
#endif

static inline void instr_set(const struct gpio_dt_spec *p, int v)
{
	if (p->port) {
		gpio_pin_set_dt(p, v);
	}
}

/* ---- ISR side ------------------------------------------------------------- */

/* Sampling tick: the ISR queues the release time and returns; the sampling
 * thread wakes on it. Ticks still pile up here if the thread falls behind. */
K_MSGQ_DEFINE(tick_q, sizeof(uint32_t), 8, 4);
static atomic_t backlog_peak; /* worst backlog seen — `status` reports it */
static atomic_t lat_peak_us;  /* worst release -> thread start */
K_SEM_DEFINE(control_sem, 0, CONTROL_EVERY);

/* Control's release times, so it can compute its own response time R even when
 * it falls more than one period behind (ring of 4 releases). */
static volatile uint32_t ctrl_rel_cyc[4];
static volatile uint32_t ctrl_rel_seq;
static atomic_t ctrl_r_peak_us; /* worst control R, release -> done */
static atomic_t ctrl_r_last_us;

/* ---- Task B: the lock shared by control (high) and the console (low) ------ */

K_SEM_DEFINE(node_sem, 1, 1); /* the wrong tool: no owner, no inheritance */
K_MUTEX_DEFINE(node_mutex);   /* Zephyr's k_mutex: priority inheritance */
static volatile bool use_mutex = true; /* ADR-002; `lock sem` breaks it on purpose */

static void node_lock(bool m)
{
	if (m) {
		k_mutex_lock(&node_mutex, K_FOREVER);
	} else {
		k_sem_take(&node_sem, K_FOREVER);
	}
}

static void node_unlock(bool m)
{
	if (m) {
		k_mutex_unlock(&node_mutex);
	} else {
		k_sem_give(&node_sem);
	}
}

K_SEM_DEFINE(ctrl_done, 0, 1); /* given after each control job: `inv` syncs on it */
K_SEM_DEFINE(tele_go, 0, 1);   /* releases telemetry's burst (the medium thread) */
static atomic_t inv_armed;     /* sampling gives tele_go with the next control release */

static void tick_isr(struct k_timer *t)
{
	uint32_t released = k_cycle_get_32();

	k_msgq_put(&tick_q, &released, K_NO_WAIT);

	atomic_val_t backlog = k_msgq_num_used_get(&tick_q);

	if (backlog > atomic_get(&backlog_peak)) {
		atomic_set(&backlog_peak, backlog);
	}
}
K_TIMER_DEFINE(tick_timer, tick_isr, NULL);

/* Flow pulses: counted in the ISR; each full batch is deferred to flow_wq. */
static atomic_t flow_pulses;
static struct gpio_callback flow_cb;
static struct k_work_q flow_wq;
static struct k_work flow_work;

static void flow_isr(const struct device *dev, struct gpio_callback *cb,
		     uint32_t pins)
{
	if (atomic_inc(&flow_pulses) + 1 >= FLOW_BATCH) {
		k_work_submit_to_queue(&flow_wq, &flow_work);
	}
}

/* ---- State ---------------------------------------------------------------- */

static int setpoint_mv = 1500;
static int pressure_mv;
static int joystick_mv = -1;
static int duty_pct;          /* valve command, 0-100 */
static int integral_mv;
static bool estop;
static float flow_lpm;        /* batch math result (float on purpose: no FPU) */
static uint32_t flow_batches;

enum page { PAGE_DASH, PAGE_FLOW, PAGE_HEALTH, PAGE_COUNT };
static int page;
static bool page_dirty = true;

/* ---- Inputs: ADC when the board wires it, a synthetic plant when not ------ */

#if HAS_ADC
static int adc_read_mv(const struct adc_dt_spec *spec)
{
	int16_t raw;
	struct adc_sequence seq = { .buffer = &raw, .buffer_size = sizeof(raw) };
	int32_t mv;

	adc_sequence_init_dt(spec, &seq);
	if (adc_read_dt(spec, &seq) < 0) {
		return -1;
	}
	mv = raw;
	adc_raw_to_millivolts_dt(spec, &mv);
	return mv;
}
#endif

/* Without a pot on the pressure channel (or on native_sim) the plant is
 * simulated: pressure drifts toward what the valve commands. */
static int plant_mv(void)
{
	static int mv = 1200;

	mv += (duty_pct * 33 - mv) / 64;
	mv += (int)(k_cycle_get_32() % 7) - 3;
	return mv;
}

static int read_pressure_mv(void)
{
#if HAS_ADC
	int mv = adc_read_mv(&adc_pressure);

	if (mv >= 0) {
		return mv;
	}
#endif
	return plant_mv();
}

static int read_joystick_mv(void)
{
#if HAS_ADC
	return adc_read_mv(&adc_joy);
#else
	return -1;
#endif
}

/* ---- Tasks ---------------------------------------------------------------- */

/* Joystick bands, single-ADC resistor ladder. Calibrate with `joy`. */
enum joy { JOY_NONE, JOY_UP, JOY_DOWN, JOY_LEFT, JOY_RIGHT, JOY_SEL };

static enum joy joy_decode(int mv)
{
	if (mv < 0) return JOY_NONE;
	if (mv < 300) return JOY_SEL;
	if (mv < 900) return JOY_DOWN;
	if (mv < 1600) return JOY_RIGHT;
	if (mv < 2300) return JOY_LEFT;
	if (mv < 3000) return JOY_UP;
	return JOY_NONE;
}

/* Joystick UX, sampled at 50 Hz: left/right turn HMI pages, up/down move the
 * setpoint on the dashboard, down *held* ~1 s is the e-stop, center clears it. */
static void joystick_update(void)
{
	static enum joy prev = JOY_NONE;
	static int down_held;

	joystick_mv = read_joystick_mv();
	enum joy j = joy_decode(joystick_mv);

	if (j == JOY_DOWN) {
		if (++down_held == ESTOP_HOLD) {
			estop = true;
			page_dirty = true;
		}
	} else {
		down_held = 0;
	}

	switch (j) {
	case JOY_UP: /* held = ramp */
		if (page == PAGE_DASH) {
			setpoint_mv = CLAMP(setpoint_mv + 10, 0, 3300);
			page_dirty = true;
		}
		break;
	case JOY_DOWN: /* single step per press; keep holding for e-stop */
		if (page == PAGE_DASH && j != prev) {
			setpoint_mv = CLAMP(setpoint_mv - 10, 0, 3300);
			page_dirty = true;
		}
		break;
	case JOY_LEFT:
		if (j != prev) {
			page = (page + PAGE_COUNT - 1) % PAGE_COUNT;
			page_dirty = true;
		}
		break;
	case JOY_RIGHT:
		if (j != prev) {
			page = (page + 1) % PAGE_COUNT;
			page_dirty = true;
		}
		break;
	case JOY_SEL:
		estop = false;
		integral_mv = 0;
		page_dirty = true;
		break;
	default:
		break;
	}
	prev = j;
}

static void task_sampling(void)
{
	static int pwm_phase;
	static int joy_div;

	instr_set(&instr_samp, 1);

	pressure_mv = read_pressure_mv();

	/* e-stop condition is *detected* here, at 1 kHz... */
	if (pressure_mv > ESTOP_MV) {
		estop = true;
		duty_pct = 0; /* ADR-005: the PWM step below drives the valve low now */
	}
	instr_set(&instr_flow, estop); /* Task C: detection marker (flow input unplugged) */

	/* joystick, decimated to 50 Hz */
	if (++joy_div >= 20) {
		joy_div = 0;
		joystick_update();
	}

	/* software PWM on the valve */
	pwm_phase = (pwm_phase + 1) % PWM_STEPS;
	if (valve_led.port) {
		gpio_pin_set_dt(&valve_led,
				pwm_phase < (duty_pct * PWM_STEPS) / 100);
	}

	instr_set(&instr_samp, 0);
}

static void task_control(void)
{
	if (estop) {
		duty_pct = 0;
	} else {
		int error = setpoint_mv - pressure_mv;

		integral_mv += error / 8;
		integral_mv = CLAMP(integral_mv, -2000, 2000);
		duty_pct = CLAMP((error + integral_mv) / 20, 0, 100);
	}
}

/* Every FLOW_BATCH pulses: convert the accumulated count to L/min and smooth
 * it. Float math on flow_wq, soft-float (CONFIG_FPU is off). */
static void task_flow_batch(void)
{
	if (atomic_get(&flow_pulses) < FLOW_BATCH) {
		return;
	}
	instr_set(&instr_flow, 1);

	float pulses = (float)atomic_clear(&flow_pulses);
	float lpm = pulses / 5880.0f * 60.0f; /* YF-S401: 5880 pulses/L */

	for (int i = 0; i < 50; i++) {
		flow_lpm = flow_lpm * 0.9f + lpm * 0.1f;
	}
	flow_batches++;

	instr_set(&instr_flow, 0);
}

static void task_telemetry(void)
{
	static int64_t next_ms;
	char line[96];

	if (k_uptime_get() < next_ms) {
		return;
	}
	next_ms += TELEMETRY_MS;
	instr_set(&instr_tele, 1);

	snprintf(line, sizeof(line),
		 "t=%u p_mv=%d sp_mv=%d duty=%d flow_x100=%d estop=%d backlog=%ld",
		 (unsigned int)k_uptime_get(), pressure_mv, setpoint_mv, duty_pct,
		 (int)(flow_lpm * 100.0f), (int)estop,
		 (long)atomic_get(&backlog_peak));
	printk("%s\n", line); /* polled UART: ~7 ms of blocking at 115200 */

	instr_set(&instr_tele, 0);
}

/* ---- Display (soft "HMI"): SSD1306 pages, redrawn whole ------------------- */

#ifdef CONFIG_CHARACTER_FRAMEBUFFER
static void task_display(void)
{
	static int64_t next_ms;
	static bool ready;
	char line[24];

	if (disp == NULL) {
		return;
	}
	if (!ready) {
		if (!device_is_ready(disp) || cfb_framebuffer_init(disp) != 0) {
			return;
		}
		display_blanking_off(disp);
		ready = true;
	}
	if (!page_dirty && k_uptime_get() < next_ms) {
		return;
	}
	next_ms = k_uptime_get() + DISPLAY_MS;
	page_dirty = false;

	instr_set(&instr_disp, 1);
	cfb_framebuffer_clear(disp, false);
	switch (page) {
	case PAGE_DASH:
		snprintf(line, sizeof(line), "P %4d>%4dmV", pressure_mv,
			 setpoint_mv);
		cfb_print(disp, line, 0, 0);
		snprintf(line, sizeof(line), "duty %3d%% %s", duty_pct,
			 estop ? "ESTOP" : "");
		cfb_print(disp, line, 0, 16);
		cfb_print(disp, "1/3 dash", 0, 48);
		break;
	case PAGE_FLOW:
		snprintf(line, sizeof(line), "flow %d.%02d L/m",
			 (int)flow_lpm, (int)(flow_lpm * 100.0f) % 100);
		cfb_print(disp, line, 0, 0);
		snprintf(line, sizeof(line), "batches %u", flow_batches);
		cfb_print(disp, line, 0, 16);
		cfb_print(disp, "2/3 flow", 0, 48);
		break;
	case PAGE_HEALTH:
		snprintf(line, sizeof(line), "up %us",
			 (unsigned int)(k_uptime_get() / 1000));
		cfb_print(disp, line, 0, 0);
		snprintf(line, sizeof(line), "backlog pk %ld",
			 (long)atomic_get(&backlog_peak));
		cfb_print(disp, line, 0, 16);
		cfb_print(disp, "3/3 health", 0, 48);
		break;
	}
	/* the whole 1 KB frame goes over I2C here, char by char: blocking */
	cfb_framebuffer_finalize(disp);
	instr_set(&instr_disp, 0);
}
#else
static void task_display(void)
{
}
#endif

/* ---- Console (firm): poll chars, run a full command synchronously --------- */

static void cmd_calib(void)
{
	k_thread_runtime_stats_t s0, s1;

	printk("calibrating zero-flow offset (%d rounds)...\n", CALIB_ROUNDS);
	k_thread_runtime_stats_get(k_current_get(), &s0);
	uint32_t c0 = k_cycle_get_32();

	for (int i = 0; i < CALIB_ROUNDS; i++) {
		(void)read_pressure_mv();
		k_usleep(400); /* ADR-005: settle asleep, not spinning */
	}

	uint32_t dur_us = k_cyc_to_us_floor32(k_cycle_get_32() - c0);

	k_thread_runtime_stats_get(k_current_get(), &s1);
	uint32_t cpu_us = (uint32_t)k_cyc_to_us_floor64(s1.execution_cycles -
						       s0.execution_cycles);

	printk("calibration done: duration %u.%03u ms, console CPU %u.%03u ms\n",
	       dur_us / 1000, dur_us % 1000, cpu_us / 1000, cpu_us % 1000);
}

/* Task B: the slow console command that holds the lock. The sequence:
 * console (low) takes the lock -> control (high) is released and asks for it
 * -> telemetry (medium) is released in the same tick and preempts the console. */
static void cmd_inv(void)
{
	const bool m = use_mutex;

	k_sem_reset(&ctrl_done);
	k_sem_take(&ctrl_done, K_MSEC(100)); /* a control job just finished...   */
	k_msleep(INV_LEAD_MS);               /* ...wake ~2 ms before the next one */
	atomic_set(&ctrl_r_peak_us, 0);

	node_lock(m);
	instr_set(&instr_disp, 1); /* critical section starts: its width is B */
	atomic_set(&inv_armed, 1); /* telemetry goes with control's next release */
	uint32_t c0 = k_cycle_get_32();

	k_busy_wait(INV_CS_US);    /* the slow work done under the lock */
	uint32_t cs_us = k_cyc_to_us_floor32(k_cycle_get_32() - c0);

	instr_set(&instr_disp, 0);
	node_unlock(m);

	k_msleep(40); /* let control and telemetry finish before reporting */
	printk("inv [lock=%s]: control R peak = %ld us, console critical section = %u us\n",
	       m ? "k_mutex" : "k_sem", (long)atomic_get(&ctrl_r_peak_us), cs_us);
}

static void console_handle(char *line)
{
	if (strcmp(line, "help") == 0) {
		printk("commands: help status joy set <mv> clear calib threads\n"
		       "          lock sem|mutex  inv  reset\n");
	} else if (strcmp(line, "status") == 0) {
		printk("p=%d mV sp=%d mV duty=%d%% flow_x100=%d estop=%d "
		       "batches=%u backlog_peak=%ld lat_peak_us=%ld\n"
		       "lock=%s ctrl_R_peak_us=%ld ctrl_R_last_us=%ld\n",
		       pressure_mv, setpoint_mv, duty_pct,
		       (int)(flow_lpm * 100.0f), (int)estop, flow_batches,
		       (long)atomic_get(&backlog_peak),
		       (long)atomic_get(&lat_peak_us),
		       use_mutex ? "k_mutex" : "k_sem",
		       (long)atomic_get(&ctrl_r_peak_us),
		       (long)atomic_get(&ctrl_r_last_us));
	} else if (strcmp(line, "joy") == 0) {
		printk("joystick raw: %d mV\n", joystick_mv);
	} else if (strncmp(line, "set ", 4) == 0) {
		const bool m = use_mutex;

		node_lock(m);
		setpoint_mv = CLAMP(atoi(line + 4), 0, 3300);
		node_unlock(m);
		printk("setpoint = %d mV\n", setpoint_mv);
	} else if (strcmp(line, "clear") == 0) {
		const bool m = use_mutex;

		node_lock(m);
		estop = false;
		integral_mv = 0;
		node_unlock(m);
		printk("e-stop cleared\n");
	} else if (strcmp(line, "lock sem") == 0) {
		use_mutex = false;
		printk("lock = k_sem (no priority inheritance)\n");
	} else if (strcmp(line, "lock mutex") == 0) {
		use_mutex = true;
		printk("lock = k_mutex (priority inheritance)\n");
	} else if (strcmp(line, "inv") == 0) {
		cmd_inv();
	} else if (strcmp(line, "reset") == 0) {
		atomic_set(&ctrl_r_peak_us, 0);
		atomic_set(&lat_peak_us, 0);
		atomic_set(&backlog_peak, 0);
		printk("peaks reset\n");
	} else if (strcmp(line, "calib") == 0) {
		cmd_calib();
#ifdef CONFIG_THREAD_ANALYZER
	} else if (strcmp(line, "threads") == 0) {
		thread_analyzer_print(0);
#endif
	} else if (line[0] != '\0') {
		printk("? (try: help)\n");
	}
}

static void task_console(void)
{
	static char buf[32];
	static size_t len;
	unsigned char c;

#if DT_HAS_CHOSEN(zephyr_console)
	while (uart_poll_in(console_uart, &c) == 0) {
		instr_set(&instr_cons, 1);
		if (c == '\r' || c == '\n') {
			buf[len] = '\0';
			printk("\n");
			console_handle(buf);
			len = 0;
		} else if (len < sizeof(buf) - 1) {
			buf[len++] = c;
			printk("%c", c);
		}
		instr_set(&instr_cons, 0);
	}
#endif
}

/* ---- Threads ------------------------------------------------------------- */

/* Rate-monotonic order: the shorter the period, the more important. `main`
 * keeps the default priority 0, so it finishes bring-up before any of these
 * runs. */
#define SAMPLING_PRIO  2
#define CONTROL_PRIO   3
#define FLOW_WQ_PRIO   5
#define DISPLAY_PRIO   7
#define TELEMETRY_PRIO 8
#define CONSOLE_PRIO   9

#define CONSOLE_POLL_MS 5  /* the S3's 128-byte RX FIFO holds ~11 ms at 115200 */
#define DISPLAY_POLL_MS 50

static void sampling_thread(void *p1, void *p2, void *p3)
{
	uint32_t released;
	int control_div = 0;

	while (1) {
		k_msgq_get(&tick_q, &released, K_FOREVER);

		atomic_val_t lat = k_cyc_to_us_floor32(k_cycle_get_32() - released);

		if (lat > atomic_get(&lat_peak_us)) {
			atomic_set(&lat_peak_us, lat);
		}

		task_sampling();
		if (++control_div >= CONTROL_EVERY) {
			control_div = 0;
			ctrl_rel_cyc[ctrl_rel_seq % ARRAY_SIZE(ctrl_rel_cyc)] = released;
			ctrl_rel_seq++;
			k_sem_give(&control_sem);
			if (atomic_cas(&inv_armed, 1, 0)) {
				k_sem_give(&tele_go); /* medium: released with control */
			}
		}
	}
}
K_THREAD_DEFINE(sampling_tid, 1536, sampling_thread, NULL, NULL, NULL,
		SAMPLING_PRIO, 0, 0);

static void control_thread(void *p1, void *p2, void *p3)
{
	uint32_t job = 0;

	while (1) {
		k_sem_take(&control_sem, K_FOREVER);

		const bool m = use_mutex;

		instr_set(&instr_ctrl, 1); /* high from wake-up: lock wait included */
		node_lock(m);
		task_control();
		node_unlock(m);
		instr_set(&instr_ctrl, 0);

		uint32_t rel = ctrl_rel_cyc[job % ARRAY_SIZE(ctrl_rel_cyc)];
		atomic_val_t r = k_cyc_to_us_floor32(k_cycle_get_32() - rel);

		job++;
		atomic_set(&ctrl_r_last_us, r);
		if (r > atomic_get(&ctrl_r_peak_us)) {
			atomic_set(&ctrl_r_peak_us, r);
		}
		k_sem_give(&ctrl_done);
	}
}
K_THREAD_DEFINE(control_tid, 1024, control_thread, NULL, NULL, NULL,
		CONTROL_PRIO, 0, 0);

static void display_thread(void *p1, void *p2, void *p3)
{
	while (1) {
		task_display();
		k_msleep(DISPLAY_POLL_MS);
	}
}
K_THREAD_DEFINE(display_tid, 2048, display_thread, NULL, NULL, NULL,
		DISPLAY_PRIO, 0, 0);

static void telemetry_thread(void *p1, void *p2, void *p3)
{
	int64_t next_ms = k_uptime_get();

	while (1) {
		task_telemetry();
		next_ms += TELEMETRY_MS;
		/* Task B: tele_go makes telemetry the medium thread: busy work that
		 * never touches the lock. Otherwise: the CSV line every second. */
		while (k_sem_take(&tele_go, K_TIMEOUT_ABS_MS(next_ms)) == 0) {
			instr_set(&instr_tele, 1);
			k_busy_wait(INV_TELE_US);
			instr_set(&instr_tele, 0);
		}
	}
}
K_THREAD_DEFINE(telemetry_tid, 2048, telemetry_thread, NULL, NULL, NULL,
		TELEMETRY_PRIO, 0, 0);

/* Polls, then sleeps: a console that spun here would starve idle. */
static void console_thread(void *p1, void *p2, void *p3)
{
	while (1) {
		task_console();
		k_msleep(CONSOLE_POLL_MS);
	}
}
K_THREAD_DEFINE(console_tid, 2048, console_thread, NULL, NULL, NULL,
		CONSOLE_PRIO, 0, 0);

/* Its own queue, not the system one: that runs at priority -1 (cooperative)
 * and would hold sampling off for the whole batch. */
K_THREAD_STACK_DEFINE(flow_wq_stack, 1024);

static void flow_work_fn(struct k_work *work)
{
	task_flow_batch();
}

/* ---- Bring-up ------------------------------------------------------------ */

static void init_hw(void)
{
	const struct gpio_dt_spec *outs[] = { &instr_samp, &instr_ctrl,
					      &instr_cons, &instr_tele,
					      &instr_flow, &instr_disp,
					      &valve_led };

	for (size_t i = 0; i < ARRAY_SIZE(outs); i++) {
		if (outs[i]->port) {
			gpio_pin_configure_dt(outs[i], GPIO_OUTPUT_INACTIVE);
		}
	}
#if HAS_ADC
	adc_channel_setup_dt(&adc_joy);
	adc_channel_setup_dt(&adc_pressure);
#endif
	if (flow_pulse.port) {
		gpio_pin_configure_dt(&flow_pulse, GPIO_INPUT);
		gpio_pin_interrupt_configure_dt(&flow_pulse,
						GPIO_INT_EDGE_TO_ACTIVE);
		gpio_init_callback(&flow_cb, flow_isr, BIT(flow_pulse.pin));
		gpio_add_callback(flow_pulse.port, &flow_cb);
	}
}

int main(void)
{
	const struct k_work_queue_config flow_wq_cfg = { .name = "flow_wq" };

	k_work_queue_start(&flow_wq, flow_wq_stack,
			   K_THREAD_STACK_SIZEOF(flow_wq_stack), FLOW_WQ_PRIO,
			   &flow_wq_cfg);
	k_work_init(&flow_work, flow_work_fn);
	init_hw();
	printk("SoilSense Control — kernel build (%s)\n", CONFIG_BOARD);
	printk("type 'help'\n");

	k_timer_start(&tick_timer, K_USEC(SAMPLE_PERIOD_US),
		      K_USEC(SAMPLE_PERIOD_US));
	return 0;
}
```
